## myKeyboardV1/zmk/boards/shields/terence0/Kconfig.defconfig
```kconfig
# Copyright (c) 2025 Terence Ng
# SPDX-License-Identifier: MIT

if SHIELD_TERENCE0_DONGLE

config ZMK_KEYBOARD_NAME
    default "Terence0"

config ZMK_SPLIT_ROLE_CENTRAL
    default y

config ZMK_USB
	default y

endif

if SHIELD_TERENCE0_LEFT || SHIELD_TERENCE0_RIGHT || SHIELD_TERENCE0_DONGLE

config ZMK_SPLIT
    default y

config ZMK_BLE
    default y

endif
```

## myKeyboardV1/zmk/config/Kconfig.defconfig
```kconfig
# Copyright (c) 2025 Terence Ng
# SPDX-License-Identifier: MIT

if SHIELD_0TERENCE_LEFT

config ZMK_KEYBOARD_NAME
    default "0terence Left"

config ZMK_SPLIT_ROLE_PERIPHERAL
    default y

endif

if SHIELD_0TERENCE_RIGHT

config ZMK_KEYBOARD_NAME
    default "0terence Right"

config ZMK_SPLIT_ROLE_PERIPHERAL
    default y

endif

if SHIELD_0TERENCE_DONGLE

config ZMK_KEYBOARD_NAME
    default "0terence"

config ZMK_SPLIT_ROLE_CENTRAL
    default y

endif

if SHIELD_0TERENCE_LEFT || SHIELD_0TERENCE_RIGHT || SHIELD_0TERENCE_DONGLE

config ZMK_SPLIT
    default y

endif
```

## myKeyboardV1/zmk/config/Kconfig.shield
```kconfig
# Copyright (c) 2025 Terence Ng
# SPDX-License-Identifier: MIT

config SHIELD_0TERENCE_LEFT
    def_bool $(shields_list_contains,0terence_left)

config SHIELD_0TERENCE_RIGHT
    def_bool $(shields_list_contains,0terence_right)

config SHIELD_0TERENCE_DONGLE
    def_bool $(shields_list_contains,0terence_dongle)
```
